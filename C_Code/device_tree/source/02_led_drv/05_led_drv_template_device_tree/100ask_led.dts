#define GROUP_PIN(g,p) ((g<<16) | (p))
//哪一种里面的哪一个引脚
/ {
	100ask_led@0 {
		compatible = "100as,leddrv";
		pin = <GROUP_PIN(3, 1)>;
	};

	100ask_led@1 {
		compatible = "100as,leddrv";
		pin = <GROUP_PIN(5, 8)>;
	};

};
//放在这个根路径下面，否则编译会出错

